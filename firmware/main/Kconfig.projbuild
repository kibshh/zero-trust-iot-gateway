## firmware/main/Kconfig.projbuild
```kconfig
menu "Zero-Trust IoT Gateway"

    menu "Wi-Fi"

        config ZTGW_WIFI_SSID
            string "Wi-Fi SSID"
            default "MyNetwork"
            help
                SSID of the Wi-Fi network to join in station mode.
                Can be overridden at runtime by storing "ssid" in NVS namespace "wifi".

        config ZTGW_WIFI_PASSWORD
            string "Wi-Fi Password"
            default ""
            help
                Password for the Wi-Fi network.
                Can be overridden at runtime by storing "password" in NVS namespace "wifi".

        config ZTGW_WIFI_CONNECT_TIMEOUT_MS
            int "Wi-Fi connect timeout (ms)"
            default 15000
            range 1000 60000
            help
                Absolute deadline for WiFiManager::connect() to obtain an IP address.
                The timer starts when esp_wifi_start() is called. If no GOT_IP event
                arrives within this window, connect() returns Timeout regardless of
                how many retries remain.

        config ZTGW_WIFI_MAX_RETRY
            int "Wi-Fi association retry count"
            default 5
            range 1 20
            help
                How many times WiFiManager retries esp_wifi_connect() after a
                DISCONNECTED event before giving up and returning AuthFailed.
                Each retry happens immediately on disconnect; backoff is not applied
                at this layer — the boot sequence handles delays between full attempts.

    endmenu

    menu "Provisioning"

        config ZTGW_PROV_AP_SSID
            string "Provisioning AP SSID"
            default "ZT-Gateway-Setup"
            help
                SSID of the softAP broadcast when the device has no Wi-Fi credentials.
                Users connect to this network and open http://192.168.4.1/provision
                to configure credentials.

        config ZTGW_PROV_AP_CHANNEL
            int "Provisioning AP channel"
            default 1
            range 1 13
            help
                Wi-Fi channel used for the provisioning softAP.
                Change if channel 1 is congested in your environment.

        config ZTGW_PROV_RESET_GPIO
            int "Credential reset button GPIO pin"
            default 0
            range 0 39
            help
                GPIO pin number for the physical credential-reset button.
                Holding this pin LOW for at least ZTGW_PROV_RESET_HOLD_MS milliseconds
                at boot erases the stored Wi-Fi credentials from NVS, forcing
                provisioning mode on the next boot.
                GPIO 0 is the BOOT button on most ESP32 dev boards.

        config ZTGW_PROV_RESET_HOLD_MS
            int "Reset button hold time (ms)"
            default 3000
            range 500 10000
            help
                How long the reset button must be held continuously before
                Wi-Fi credentials are erased from NVS. The hold may start
                anywhere inside the detection window and may extend past it.
                Shorter values risk accidental resets; longer values are inconvenient.

        config ZTGW_PROV_RESET_WINDOW_MS
            int "Reset button detection window (ms)"
            default 5000
            range 1000 30000
            help
                How long after boot the device waits for the user to start pressing
                the reset button. The LED blinks fast throughout this window.
                Must be >= ZTGW_PROV_RESET_HOLD_MS so the user has time to press
                and hold within the window.

        config ZTGW_PROV_LED_GPIO
            int "Status LED GPIO pin"
            default 2
            range 0 39
            help
                GPIO pin connected to the status LED (active HIGH).
                The LED blinks fast during the reset detection window to signal
                that the device is ready to accept a credential-reset button press.
                GPIO 2 is the built-in LED on most ESP32 dev boards.

    endmenu

    menu "Backend"

        config ZTGW_BACKEND_URL
            string "Backend base URL"
            default "https://192.168.1.100:8080"
            help
                Base URL of the backend server (no trailing slash).
                This is the trusted baseline compiled into the firmware.
                In production builds, runtime override is disabled.
                In development builds (ZTGW_BACKEND_ALLOW_NVS_OVERRIDE=y),
                the value stored as "url" in NVS namespace "backend" takes precedence.

        config ZTGW_BACKEND_TIMEOUT_MS
            int "Backend request timeout (ms)"
            default 10000
            range 1000 60000
            help
                Per-request HTTP timeout in milliseconds.
                Tunable at runtime via NVS when ZTGW_BACKEND_ALLOW_NVS_OVERRIDE is enabled.

        config ZTGW_BACKEND_PUBKEY_DER_HEX
            string "Backend signing public key (DER hex)"
            default ""
            help
                Hex-encoded DER SubjectPublicKeyInfo of the backend's ECDSA P-256 signing key.
                Backend-issued policies are verified against this key.
                This value is the trust anchor and must always be set in production.
                It is paired with ZTGW_BACKEND_URL — both must be updated together
                when rotating the backend identity.

        config ZTGW_BACKEND_ALLOW_NVS_OVERRIDE
            bool "Allow backend URL/timeout to be overridden from NVS (development only)"
            default n
            help
                When enabled, values stored in NVS namespace "backend" (keys: "url",
                "timeout_ms") override the Kconfig defaults at runtime.
                NEVER enable in production — it allows redirecting the device to an
                untrusted backend. The pinned public key is never overridable via NVS.

    endmenu

endmenu
```

## firmware/sdkconfig.defaults
```kconfig
# Zero-Trust IoT Gateway – Security Baseline
# (Development / Reversible)

# Logging (safe default)
CONFIG_LOG_DEFAULT_LEVEL_INFO=y              # Set default log level to INFO
CONFIG_LOG_DEFAULT_LEVEL=3                   # Numeric log level (3 = INFO)

# Flash integrity
CONFIG_SPI_FLASH_VERIFY_WRITE=y              # Verify data after writing to flash to detect corruption

# Brownout protection
CONFIG_ESP32_BROWNOUT_DET=y                  # Enable brownout detector to reset on voltage drops
CONFIG_ESP32_BROWNOUT_DET_LVL_SEL_7=y        # Set brownout threshold to level 7 (2.51V)

# Crypto acceleration
CONFIG_MBEDTLS_HARDWARE_AES=y                # Use hardware AES acceleration for faster encryption
CONFIG_MBEDTLS_HARDWARE_SHA=y                # Use hardware SHA acceleration for faster hashing
CONFIG_MBEDTLS_HARDWARE_MPI=y                # Use hardware acceleration for big integer operations
CONFIG_MBEDTLS_HARDWARE_ECC=y                # Use hardware acceleration for elliptic curve cryptography
CONFIG_MBEDTLS_ECP_RESTARTABLE=y             # Enable restartable ECC operations for better performance
```
